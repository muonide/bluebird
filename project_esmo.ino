#include <Structure.h>
#include <Ethernet.h>
#include <avr/pgmspace.h>

// ******** DEBUG ==== should auto config to adapt different mother board *********
//#define DATA_1 (PORTF |=  0X01)    // DATA 1    // for ATMEGA
//#define DATA_0 (PORTF &=  0XFE)    // DATA 0    // for ATMEGA
//#define STRIP_PINOUT DDRF=0xFF  // for ATMEGA
#define DATA_1 (PORTC |=  0X01)    // DATA 1    // for UNO      this PORTC basically controls the analog output 
#define DATA_0 (PORTC &=  0XFE)    // DATA 0    // for UNO      DATA_1 is high; DATA_0 is low. binary signal is generated by sending a DATA_1, specified delay, then set DATA_0
#define STRIP_PINOUT (DDRC=0xFF)    // for UNO
#define numBufSize 6
unsigned long color;


byte mac[] = { 0xDE, 0xAD, 0xBE, 0xEF, 0xFE, 0xED };

IPAddress ip(192, 168, 0, 177);

EthernetClient client;

StructureDevice device(STRUCTURE_DEVICE_ID);

// Structure credentials.
const char* STRUCTURE_DEVICE_ID = "56fbe4b0a7be2d0100bf6de7";
const char* STRUCTURE_ACCESS_KEY = "4af03ec1-09e1-4910-baf4-4169b69c4f49";
const char* STRUCTURE_ACCESS_SECRET = "c782fb4570c37ee59e331a5089dfa39754682adc49f402ff16df3367dbd6b7df";


void handleCommand(StructureCommand *command) {
  Serial.print("Command received: ");
  Serial.println(command->name);

//convert string of Hexidecimal representation to HEX
//then set color = to that.  loop takes care of the rest.
//e.g.
if(strcmp(command->name, "red") == 0);{
color = 0xFF0000;
}

}

void setup() {
  Serial.begin(9600);
  while(!Serial) {}

  STRIP_PINOUT;        // set output pin - DEBUG: should auto detect which mother board for use

  reset_strip();
  //noInterrupts();

  // start the Ethernet connection:
  if (Ethernet.begin(mac) == 0) {
    Serial.println("Failed to configure Ethernet using DHCP");
    // try to congifure using IP address instead of DHCP:
    Ethernet.begin(mac, ip);
  }
  // give the Ethernet shield a second to initialize:
  delay(1000);
  Serial.println("connecting...");

device.connectSecure(client, STRUCTURE_ACCESS_KEY, STRUCTURE_ACCESS_SECRET);

while(!device.connected()) {
  delay(500);
  Serial.print(".");
}

Serial.println("Connected!");

  device.onCommand(&handleCommand);
}

void loop() {
  device.loop();
  
  send_strip(color);       //using only one strip of 3 RGB LEDs
  delay(100); 
  
}

void send_strip(uint32_t data)
{
  int i;
  unsigned long j=0x800000;
  
 
  for (i=0;i<24;i++)
  {
    if (data & j)
    {
      DATA_1;
      __asm__("nop\n\t");          //__asm__ is an assembly command.  This specific one tells the arduino to delay one cycle
      __asm__("nop\n\t");          //  for 16 MHz clock speed, that's 62.5 nanoseconds.  The delay() command has a minimum of 2 microseconds.
      __asm__("nop\n\t");          //  here we need 1.8 microsecond and 0.7 microsecond delays for the data timing
      __asm__("nop\n\t");          //  this portion of the code takes the data stream and converts digital 1's and 0's to high & low, respectively
      __asm__("nop\n\t");          //  see the Radioshack product sheet for pulse structure diagrams
      __asm__("nop\n\t");
      __asm__("nop\n\t");
      __asm__("nop\n\t");
      __asm__("nop\n\t");    
      __asm__("nop\n\t");
      __asm__("nop\n\t");
      __asm__("nop\n\t");
      __asm__("nop\n\t");
      __asm__("nop\n\t");
      __asm__("nop\n\t");
      __asm__("nop\n\t");
      __asm__("nop\n\t");
      __asm__("nop\n\t");
      DATA_0;
    }
    else
    {
      DATA_1;
      __asm__("nop\n\t");
      __asm__("nop\n\t");
      __asm__("nop\n\t");
      __asm__("nop\n\t");
      __asm__("nop\n\t");
      __asm__("nop\n\t");
      __asm__("nop\n\t");
      __asm__("nop\n\t");
      __asm__("nop\n\t");    
      DATA_0;
    }

    j>>=1;
  }


  
}

/*******************************************************************************
 * Function Name  : reset_strip
 * Description    : Send reset pulse to reset all color of the strip
 *                  
 * Input          : None
 *                  
 * Output         : None
 * Return         : None
 *******************************************************************************/
void  reset_strip()
{
  DATA_0;            //long pause for reset
  delayMicroseconds(20);
}










